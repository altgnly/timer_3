	__CONFIG H'F31'
	LIST P=16F877A
	#INCLUDE <P16F877A.INC>
	SAYAC EQU 0X20
	ORG 0X000
	GOTO ANA_METOT
	ORG 0X004
	
KESME_METOT
	BTFSS INTCON,TMR0IF
	RETFIE
	BCF INTCON,TMR0IF

	MOVLW H'6'
	MOVWF TMR0

	DECFSZ SAYAC,F
	RETFIE

	MOVLW D'250'
	MOVWF SAYAC

	MOVF PORTC,W
	SUBLW D'0'
	BTFSC STATUS,Z
	GOTO TEKRAR_METOT
	DECF PORTC,F

	RETFIE

ANA_METOT
	BANKSEL TRISC
	CLRF TRISC
	BANKSEL PORTC
	CLRF PORTC

	BANKSEL INTCON
	MOVLW B'11100000'
	MOVWF INTCON
	BANKSEL INTCON

	BANKSEL OPTION_REG
	MOVLW B'00000010'
	MOVWF OPTION_REG
	BANKSEL OPTION_REG

	BANKSEL TMR0
	MOVLW H'6'
	MOVWF TMR0
	CLRF SAYAC
	MOVLW D'250'
	MOVWF SAYAC
	BANKSEL TMR0

TEKRAR_METOT
	MOVLW D'9'
	MOVWF PORTC

KONTROL
	GOTO KONTROL

END